## drivers/input/touchscreen/nt36532e/Kconfig
```kconfig
#
# Novatek NT36532E touchscreen driver configuration
#
config TOUCHSCREEN_NT36532E_SPI
	tristate "Novatek NT36532E host download SPI driver"
	default n
	help
	  Say Y here if you have a Novatek NT36532E no flash touchscreen connected
	  to your system by SPI bus.

	  If unsure, say N.
```
